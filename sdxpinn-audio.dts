/dts-v1/;
/plugin/;

#include <dt-bindings/clock/qcom,gcc-sdxpinn.h>
#include <dt-bindings/interrupt-controller/arm-gic.h>
#include <dt-bindings/interconnect/qcom,sdxpinn.h>
#include <dt-bindings/regulator/qcom,rpmh-regulator-levels.h>

#include "sdxpinn-audio.dtsi"

/ {

	model = "Qualcomm Technologies, Inc. SDXPINN";
	compatible = "qcom,sdxpinn";
	qcom,msm-id = <556 0x10000>, <580 0x10000>;
	qcom,board-id = <0 0>;
};
